/*
 * Device tree overlay for lis3dh on i2c.1
 */
/dts-v1/;
/plugin/;

/ {

	compatible = "brcm,bcm2835", "brcm,bcm2836", "brcm,bcm2708", "brcm,bcm2709";

	/* the i2c config of the controller */
	fragment@0 {
		target = <&i2c1>;
		__overlay__ {
			#address-cells = <1>;
			#size-cells = <0>;
			lis3dh@18 {
				compatible = "st,lis3dh-accel";
        reg = <0x18>;
        status = "okay";
			};
		};
	};

};
